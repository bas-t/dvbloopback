## Kconfig.patch
```kconfig
--- drivers/media/pci/Kconfig	2014-12-07 23:21:05.000000000 +0100
+++ drivers/media/pci/Kconfig	2014-12-12 10:25:02.325177377 +0100
@@ -30,6 +30,7 @@
 source "drivers/media/pci/cx25821/Kconfig"
 source "drivers/media/pci/cx88/Kconfig"
 source "drivers/media/pci/bt8xx/Kconfig"
+source "drivers/media/pci/saa716x/Kconfig"
 source "drivers/media/pci/saa7134/Kconfig"
 source "drivers/media/pci/saa7164/Kconfig"
 
```

## drivers/media/pci/saa716x/Kconfig
```kconfig
config VIDEO_SAA716X
	tristate "SAA7160/1/2 based Budget PCIe cards (DVB only)"
	depends on DVB_CORE && PCI && I2C
	select I2C_MUX
	select DVB_SI2168 if MEDIA_SUBDRV_AUTOSELECT
	select MEDIA_TUNER_SI2157 if MEDIA_SUBDRV_AUTOSELECT
	default m
```

## dvbloopback/Kconfig
```kconfig
config DVB_LOOPBACK_ADAPTER
	tristate "A loopback interface to a real DVB adapter"
	depends on MEDIA_SUPPORT && DVB_CORE
	default m
```
